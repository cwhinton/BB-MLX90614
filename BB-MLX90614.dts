/dts-v1/;
/plugin/;

/{ /* this is our device tree overlay root node */

  compatible = "ti,beaglebone", "ti,beaglebone-black";
  part-number = "BBB-MLX90614"; // you can choose any name here but it should be memorable
  version = "00A0";


  fragment@0 {
    target = <&i2c2>;

    __overlay__ {

      mlx90614: mlx90614@5a { /* the Melexis Contact-less Infrared Sensor defined as child of the i2c2 bus */
        reg = <0x5a>;
        compatible = "melexis,mlx90614";
        address-cells = <0x1>;
        size-cells = <0x1>;
      };
    };
  };
}; /* root node end */

